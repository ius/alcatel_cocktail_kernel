## Kconfig
```kconfig
#
# For a description of the syntax of this configuration file,
# see Documentation/kbuild/kconfig-language.txt.
#
mainmenu "Linux/$ARCH $KERNELVERSION Kernel Configuration"

config SRCARCH
	string
	option env="SRCARCH"

config KERNEL_PANIC_LOG
	default y
	bool "JRD KERNEL_PANIC_LOG"

source "arch/$SRCARCH/Kconfig"
```

## drivers/video/msm/Kconfig
```kconfig
source "drivers/video/msm/vidc/Kconfig"

config FB_MSM
	tristate
	depends on FB && ARCH_MSM
	select FB_CFB_FILLRECT
	select FB_CFB_COPYAREA
	select FB_CFB_IMAGEBLIT
	default y

config FB_MSM_LCDC
	bool "Support for integrated LCD controller in qsd8x50"
	depends on FB_MSM && MSM_MDP31
	default y


config FIX_BOOTUP_BLINK
	bool "Fix blink from bootloader to kernel with MDDI interface"
	depends on FB_MSM && FB_MSM_MDDI
	default n
	
config MDDI_HIMAX_24BIT_WORKROUND
	bool "Fix mddi himax controller hibernate bug"
	depends on FB_MSM && FB_MSM_MDDI && FB_MSM_MDDI_RY002Z
	default n
```
